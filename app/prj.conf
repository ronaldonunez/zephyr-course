## Kconfig
```
menuconfig LED_SUBSYSTEM
	bool "LED subsystem"
	default n
	help
	  Light emitter diode subsystem

if LED_SUBSYSTEM

choice 
	prompt "LED blink sleep time"
	default LED_TIME_1000_MS

config LED_TIME_250_MS
	bool "Fast (250ms)"

config LED_TIME_1000_MS
	bool "Medium (1s)"

config LED_TIME_2000_MS
	bool "Slow (2s)"
endchoice

config BLINK_SLEEP_TIME_MS
	int # No prompt --> hidden
	default 250 if LED_TIME_250_MS
	default 1000 if LED_TIME_1000_MS
	default 2000 if LED_TIME_2000_MS
	default 0

menuconfig LED_ADVANCED_SETTINGS
	bool "Advanced LED settings"
	default n
	help
	  Advanced options and params for LEDs

if LED_ADVANCED_SETTINGS

config LED_BRIGHTNESS
	int "LED brigthness (0-100)"
	range 0 100
	default 100
config LED_FADE_DURATION_MS
	int "Fade duration (ms)"
	range 0 5000
	default 500

menu "Expert settings"
config LED_DEBUG
	bool "Enable LED debugging"
config LED_DEBUG
	bool "Custom blink pattern"
endmenu

endif #LED_ADVANCED_SETTINGS

endif #LED_SUBSYSTEM

config APP_HEARTBEAT_PERIOD_MS
	int "Heartbeat period (ms)"
	range 100 2000
	default 500

source "Kconfig.zephyr"
```

## prj.conf
```kconfig
CONFIG_GPIO=y
CONFIG_LOG=y
CONFIG_LED_SUBSYSTEM=y
CONFIG_LED_TIME_1000_MS=y
```

## app.overlay
```dts
/ {
	aliases {
		greenled = &led;
	};
};
```

## src/main.cpp
```c
#include <zephyr/drivers/gpio.h>
#include <zephyr/kernel.h>
#include <zephyr/logging/log.h>

/* The devicetree node identifier for the "led-green" alias. */
#define LED_NODE DT_ALIAS(greenled)

static const struct gpio_dt_spec led = GPIO_DT_SPEC_GET(LED_NODE, gpios);

LOG_MODULE_REGISTER(main, LOG_LEVEL_INF);

int main(void)
{
    bool led_state = true;

    if (!gpio_is_ready_dt(&led)) return 0;

    if (gpio_pin_configure_dt(&led, GPIO_OUTPUT_ACTIVE) < 0) return 0;

    while (1) {
        if (gpio_pin_toggle_dt(&led) < 0) return 0;

        led_state = !led_state;
        LOG_INF("LED state: %s", led_state ? "ON" : "OFF");
        k_msleep(CONFIG_APP_HEARTBEAT_PERIOD_MS);
    }
    return 0;
}
```
